## config/west.yml
```yaml
manifest:
    defaults:
        revision: main
    remotes:
        - name: zmkfirmware
          url-base: https://github.com/zmkfirmware
        - name: m165437 #modded nice!view display
          url-base: https://github.com/M165437
    projects:
        - name: zmk
          remote: zmkfirmware
          import: app/west.yml
        - name: nice-view-gem #modded nice!view display
          remote: m165437
          revision: main
    self:
        path: config
```
